## src/examples/fly_100m/Kconfig
```kconfig
menuconfig EXAMPLES_FLY_100M
	bool "examples_fly_100m"
	default n
	---help---
		Enable support for fly_100m
```

## src/examples/px4_yube_app/Kconfig
```kconfig
menuconfig EXAMPLES_PX4_YUBE_APP
	bool "px4_yube_app"
	default n
	---help---
		Enable support for px4_yube_app
```
